## config.in
```kconfig
    config VENC_HISI
        bool "venc hisi implementation"
            default false
        help
            Enable the HiSilicon implementation in libvideo-encode.

    config VENC_QCOM
        bool "venc qcom implementation"
            default false
        help
            Enable the Qualcomm implementation in libvideo-encode.

    config VENC_QCOM_JPEG
        bool "venc qcom JPEG implementation"
            default false
        help
            Enable the Qualcomm JPEG implementation in libvideo-encode.

    config VENC_X264
        bool "venc x264 implementation"
            default false
        help
            Enable the x264 implementation in libvideo-encode.

    config VENC_X265
        bool "venc x265 implementation"
            default false
        help
            Enable the x265 implementation in libvideo-encode.

    config VENC_FAKEH264
        bool "venc fakeh264 implementation"
            default false
        help
            Enable the fake H.264 implementation in libvideo-encode.

     config VENC_FFMPEG
        bool "venc ffmpeg implementation"
            default false
        help
            Enable the ffmpeg implementation in libvideo-encode.

    config VENC_MEDIACODEC
        bool "venc mediacodec implementation"
            default false
        help
            Enable the MediaCodec implementation in libvideo-encode.

    config VENC_VIDEOTOOLBOX
        bool "venc videotoolbox implementation"
            default false
        help
            Enable the VideoToolBox implementation in libvideo-encode.

    config VENC_TURBOJPEG
        bool "venc turbojpeg implementation"
            default false
        help
            Enable the turbojpeg implementation in libvideo-encode.

    config VENC_PNG
        bool "venc png implementation"
            default false
        help
            Enable the png implementation in libvideo-encode.
```
